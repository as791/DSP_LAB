//float x[] = {-148.6621707,-248.3187771,-267.1305467,-264.039437,-268.3502072,-258.1467536,-219.1794221,-281.6557217,-225.8426497,-274.0979379,-279.9389094,-256.8846671,-255.4500465,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-215.9746394,-210.90232};
float x[] = {-0.014679403,-0.021546068,-0.029541917,-0.021668142,-0.003906369,-0.000518815,0.015533921,0.028077029,0.02191229,0.018311106,0.003357036,-0.018219551,-0.027680289,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-0.025849178
};

const int n = 500;
void moving_average(float* x, float* y)
{
  int l=8;  //window size for moving average.
  for(int i=0;i<n;i++)
  {
    for(int j=0;j<l;j++)
    {
      if(i>=j)
        y[i]+=x[i-j];
    }
    y[i]/=l;
  }
}
void acf(float* x, int mean, float* R){
  float R0 = 0;
  for(int i=0;i<n;i++)
  {
    x[i] = x[i] - mean;
  }
  for(int i=0;i<n;i++)
  {
    R0+= x[i]*x[i];
  }
  for(int i=0;i<n;i++)
  {
    for(int j=0;j<n-i;j++)
    {
      R[i]+=x[j]*x[j+i];
    }
    R[i]/=R0;
  }
}
//float pulse_rate(float* )
void setup() {
  // put your setup code here, to run once:
  Serial.begin(9600);
}

void loop() {
  // put your main code here, to run repeatedly:
  float avg_rate = 0;
  float avg_pitch_period = 0;
  for(int k=0;k<4;k++)
  {
    float input_x[n]={0};
    for(int i=0;i<n;i++)
    {
     input_x[i] = x[i+k*n];
    }
    float filtered_x[n]={0};
    moving_average(input_x,filtered_x);
    float mean = 0;
    for(int i=0;i<n;i++)
    {
      mean+=filtered_x[i];
    }
    mean = mean/n;
    float R[n] = {0};
    acf(filtered_x,mean,R);
    int fzcp =0;
    for(int i=1;i<n-1;i++)
    {
      if(R[i-1]>0&&R[i+1]<0)
        {
          fzcp = i;
          break;
        }
    }
    int lmax = 0;
    float max_= 0;
    for(int i=fzcp;i<n;i++)
    {
      if(max_<R[i])
        {
          max_ = R[i];
          lmax = i;
        }
    }
//  float period_time = lmax/100.0; // Fs=100;
//  float pulse_rate = 60.0/period_time;
    float pitch_period = lmax/8000.0;
//    for(int i=0;i<n;i++)
//    {
//      Serial.print(input_x[i]);
//      Serial.print(",");
//      Serial.print(filtered_x[i]+250);
//      Serial.print(",");
//      Serial.println(R[i]*200+500);
//    }
//   avg_rate+=pulse_rate;
//   Serial.println(pulse_rate);
      avg_pitch_period+=pitch_period;
     Serial.println(1.0/pitch_period);
  }
//  avg_rate/=4;
//  Serial.print("average_pulse_rate:- ");
//  Serial.println(avg_rate); 
    avg_pitch_period/=4;
    Serial.print("average_pitch_frequency:- ");
    Serial.println(1.0/avg_pitch_period);
}
