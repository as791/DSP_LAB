

 ///////////////////////////////////////////////////////////////////////// Experiment - 1 ///////////////////////////////////////////////////////////////////////////////////////////////////// 
 
// Answers to the questions and thier implementation on hand with given PPG signal data.
//  
// a) The filter that smooth out high frequency noises that we want a LPF to be implemented i.e. MA Filter with large length (L).
// b) Derivative filters emphasizes the high slopes data in given data so using that filter for part-b
// c) Here we have to design MA Filter of L = floor(0.8*N) where N is size of data for extracting the baseline drift.
// d) Here first we have to apply first order derivative filter then MA Filter simulatenously of L=8.
//
//////////////////////////////////////////////////////////////////////////////////////////////////////////////////////////////////////////////////////////////////////////////////////////////

//////////////////////////////////////////////////////////////// Begining of the Code ////////////////////////////////////////////////////////////////////////////////////////////////////////
 
//////////////////////////////////////////////////////// Variables, Input and Output Initialization //////////////////////////////////////////////////////////////////////////////////////////

float x[]={-170.2280686,-245.299872,-225.747207,-250.9921812,-226.70691,-246.6909164,-246.1738123,-211.2549165,-219.9085797,-186.4930788,-186.1905097,-242.341203,-218.7244932,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-122.3442795
};
const int n = sizeof(x)/sizeof(float);  // size of the data.
float y[n]={0};
int l = 8; // for a)  try different lengths to show effect of MA Filter as length increases :- 8,40,80. 
//int l = floor(0.8*n); // For part d) as given in question

///////////////////////////////////////////////////////// Declaring the functions to be used ///////////////////////////////////////////////////////////////////////////////////////////////// 

// Moving Average Filter of length L
// Can denoted by following difference equation:-
// y[n] = (1/L)(x[n]+x[n-1]+x[n-2]+.....+x[n-(L-1)]) 

void maf(float* x,float* y){
  for(int i=0;i<n;i++){
    float sum=0;
    for(int j=0;j<l;j++){
        if(i>=j)
        sum = sum + x[i-j];
    } 
    y[i] = sum/l;
  }
}

// Derivative Filters
//  1. First Order Difference Filter :- y[n] = x[n]-x[n-1]
//  2. Three Point Central Difference Filter :- y[n] = x[n]-x[n-2]

void first_order(float* x ,float* y)
{
  for(int i=1;i<n;i++)
  {
    y[i] = x[i] - x[i-1];
  }
}
void three_point(float* x,float* y){
  for(int i=2;i<n;i++)
  {
    y[i] = x[i] - x[i-2];
  }
}

/////////////////////////////////////////////////////////////// Main Setup and Loop /////////////////////////////////////////////////////////////////////////////////////////////////////////////

void setup() {
  Serial.begin(9600); // serial initialization:
}
void loop() {
//  for(int i=0;i<n;i++){         // Display the given PPG signal
//    Serial.println(x[i]);
//  }
  
//  first_order(x,y);
//  three_point(x,y);
  maf(x,y);

for(int i=0;i<n;i++){         // Display the given signal along with filtered output with y axis shifted above with 200 units.
    Serial.print(x[i]);       
    Serial.print(",");
    Serial.println(y[i]+400);
  }
}
////////////////////////////////////////////////////////////////// End of the Code /////////////////////////////////////////////////////////////////////////////////////////////////////////////
