#include<arduinoFFT.h>

//double x[]={-87.17307638,-109.5495333,11.00037444,163.4286511,199.1497693,123.5660003,56.25558579,11.87495703,-18.97729813,-42.98507139,-49.50432452,-44.95819516,-33.93206642,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-17.77934267
//};//signal 1 Fs=25Hz 
double x[]={-372.3628292,50.75906574,499.6210468,-336.9832284,-194.504521,-570.4131983,-129.7377686,560.0176664,-162.6301843,-241.049091,-345.3768694,-246.2627394,-532.3337975,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62.12691402
};// signal 2 Fs=10Hz
const int n = sizeof(x)/sizeof(double);
const double Fs=10;//25
const int l=8;
const int samples = pow(2,ceil(log(n)/log(2)));
int exponent;
//0.005Hz to 0.5Hz i.e. k1=1, k2=15, signal info :- Fs=10 for 30sec
const int k1=1;
const int k2=15;
arduinoFFT FFT = arduinoFFT();

void setup() {
  Serial.begin(9600);
  exponent = FFT.Exponent(samples);
}

void loop() {
  double y[n];

  //moving average filter
  for(int i=0;i<n;i++)
  {
    y[i]=0;
    for(int j=0;j<l;j++)
    {
      if(i>=j)
      y[i]+=x[i-j];
    }
    y[i]/=l;
  }

  //mean normalization
  double mean=0;
  for(int i=0;i<n;i++)
  {
    mean+=y[i];
  }
  mean/=n;
  for(int i=0;i<n;i++)
  {
    y[i]-=mean;
  }

  
  //DFT
  double X_mag[n];
  double X_real[n];
  double X_imag[n];
  for(int i=0;i<n;i++)
  {
    double real=0,imag=0;
    for(int j=0;j<n;j++)
    {
      real+=y[j]*cos(2*PI*i*j/n);
      imag+=y[j]*sin(2*PI*i*j/n);
    }
    X_real[i]=real;X_imag[i]=imag;
    X_mag[i]=sqrt(pow(real,2)+pow(imag,2));
  }
  
  //Data Prep for IDFT For respiration (0.005Hz to 0.5Hz i.e. k1=1, k2=15, signal info :- Fs=10 for 30sec) 
  double X_real1[n],X_mag1[n],X_imag1[n];
  for(int i=0;i<n;i++)
  {
    if(i>=k1&&i<=k2)
    {
      X_imag1[i]=X_imag[i];
      X_real1[i]=X_real[i];
      X_mag1[i]=X_mag[i];
    }
    else
    {
      X_imag1[i]=0;
      X_real1[i]=0;
      X_mag1[i]=0;
    }
  }
  
  //peak point detection
  int p=0;
  double max_f=0;
  for(int i=0;i<n/2;i++)
  {
    if(max_f<X_mag1[i])
    {
      p=i;
      max_f=X_mag1[i];
    }
  }
// Serial.println(60*p*Fs/n);
 

  //IDFT
  double x_rec[n];
  for(int i=0;i<n;i++)
  {
    x_rec[i]=0;
    for(int j=0;j<n;j++)
    {
      x_rec[i]+=X_real[j]*cos(2*i*j*PI/n)+X_imag[j]*sin(2*i*j*PI/n);
    }
    x_rec[i]/=n;
  }
  
//  for(int i=0;i<n;i++)
//  {
//    Serial.println(x_rec[i]);
//  }

  //Data Prep for FFT
  double vImag[samples],vReal[samples];
  for(int i=0;i<samples;i++)
  {
    if(i<n)
      vReal[i]=y[i];
    else
      vReal[i]=0;
      
    vImag[i]=0;
  }
  //FFT
 
  FFT.Compute(vReal,vImag,samples,exponent,FFT_FORWARD);
  FFT.ComplexToMagnitude(vReal,vImag,samples);
//  double peak = FFT.MajorPeak(vReal,samples,Fs);
//  Serial.println(peak*60);

  //Data Prep for IFFT For respiration (0.005Hz to 0.5Hz i.e. k1=1, k2=15, signal info :- Fs=10 for 30sec) 
  double vReal2[samples],vImag2[samples];
  for(int i=0;i<samples;i++)
  {
    if(i>=k1&&i<=k2)
      {
        vReal2[i]=vReal[i];
        vImag2[i]=vImag[i];
      }
    else{
      vReal2[i]=0;
      vImag2[i]=0;
    }
  }
//  double peak = FFT.MajorPeak(vReal2,samples,Fs);
//  Serial.print(60*peak);

//  IFFT 
  FFT.Compute(vReal2,vImag2,samples,exponent,FFT_REVERSE);
  for(int i=0;i<samples;i++)
  {
    Serial.println(vReal2[i]);
  }
  while(1);
 
}
